## logger/sdkconfig.defaults
```kconfig
# CONFIG_ESP_CONSOLE_USB_CDC=y
# CONFIG_ESP_CONSOLE_UART_DEFAULT is not set
# CONFIG_ESP_CONSOLE_UART_NUM=-1
# CONFIG_VFS_SUPPORT_TERMIOS=y
# CONFIG_ESP_CONSOLE_USB_CDC_RX_BUF_SIZE=64
# CONFIG_ESP_CONSOLE_USB_CDC_SUPPORT_ETS_PRINTF=y

CONFIG_HTTPD_MAX_REQ_HDR_LEN=2048
CONFIG_HTTPD_MAX_URI_LEN=512
CONFIG_APP_WIFI_STA_SSID=""
CONFIG_APP_WIFI_STA_PASSWORD=""
CONFIG_APP_WIFI_AP_SSID="3PLogger"
CONFIG_APP_WIFI_AP_PASSWORD="3PLogger"
CONFIG_APP_WIFI_AP_CHANNEL=1
```
